## app/launcher/Kconfig
```kconfig
#
# For a description of the syntax of this configuration file,
# see the file kconfig-language.txt in the NuttX tools repository.
#

config LVX_USE_DEMO_LAUNCHER
	bool "LVGL launcher"
	default n
	depends on GRAPHICS_LVGL && BUILTIN
	select LV_USE_NUTTX
	select LV_USE_NUTTX_TOUCHSCREEN
	select LVX_UI
	select SCHED_WAITPID
	---help---
		Lock screen and dashboard home that lists and starts LVGL
		builtin apps.

if LVX_USE_DEMO_LAUNCHER

config LVX_LAUNCHER_APPS
	string "Apps on the all apps page"
	default ""
	---help---
		Space separated list of apps, e.g. "paint bench lvgl_widgets".
		An entry is a builtin name, or a name from the launcher's app
		table that starts a builtin with an argument (lvgl_widgets runs
		"lvdemo widgets").  Apps that are not built in are skipped.

config LVX_LAUNCHER_PINNED
	string "Apps pinned to the home screen"
	default "paint bench monitor"
	---help---
		Space separated entries of LVX_LAUNCHER_APPS that get a tile on
		the home screen.  All of them are on the all apps page.

endif
```
